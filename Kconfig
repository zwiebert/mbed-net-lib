## Kconfig
```kconfig
rsource "components/net_http_server/Kconfig"
rsource "components/net/Kconfig"
rsource "components/net_mqtt_client/Kconfig"
```

## Kconfig.projbuild
```kconfig
rsource "components/cli/Kconfig"
rsource "components/config_kvs/Kconfig"
rsource "components/firmware_update/Kconfig"
rsource "components/net_http_server/Kconfig"
rsource "components/net/Kconfig"
rsource "components/net_mqtt_client/Kconfig"
rsource "components/stm32/Kconfig"
rsource "components/txtio/Kconfig"
rsource "components/uout/Kconfig"
rsource "external/util-components/Kconfig.projbuild"
rsource "components/weather/Kconfig"
```
